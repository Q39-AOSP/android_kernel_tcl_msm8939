/* Copyright (c) 2017, The Linux Foundation. All rights reserved.
 *
 * This program is free software; you can redistribute it and/or modify
 * it under the terms of the GNU General Public License version 2 and
 * only version 2 as published by the Free Software Foundation.
 *
 * This program is distributed in the hope that it will be useful,
 * but WITHOUT ANY WARRANTY; without even the implied warranty of
 * MERCHANTABILITY or FITNESS FOR A PARTICULAR PURPOSE.  See the
 * GNU General Public License for more details.
 */
 
 &mdss_mdp {
	dsi_nt35596_auo_1080p_skuk_video: qcom,mdss_dsi_nt35596_auo_1080p_skuk_video {
				qcom,mdss-dsi-panel-name = "nt35596 auo 1080p video mode dsi panel skuk";
				qcom,mdss-dsi-panel-controller = <&mdss_dsi0>;
				qcom,mdss-dsi-panel-type = "dsi_video_mode";
				qcom,mdss-dsi-panel-destination = "display_1";
				qcom,mdss-dsi-panel-framerate = <0x3c>;
				qcom,mdss-dsi-virtual-channel-id = <0x0>;
				qcom,mdss-dsi-stream = <0x0>;
				qcom,mdss-dsi-panel-width = <0x438>;
				qcom,mdss-dsi-panel-height = <0x780>;
				qcom,mdss-dsi-h-front-porch = <0x68>;
				qcom,mdss-dsi-h-back-porch = <0x38>;
				qcom,mdss-dsi-h-pulse-width = <0x14>;
				qcom,mdss-dsi-h-sync-skew = <0x0>;
				qcom,mdss-dsi-v-back-porch = <0x3>;
				qcom,mdss-dsi-v-front-porch = <0x3>;
				qcom,mdss-dsi-v-pulse-width = <0x2>;
				qcom,mdss-dsi-bpp = <0x18>;
				qcom,mdss-dsi-color-order = "rgb_swap_rgb";
				qcom,mdss-dsi-underflow-color = <0xff>;
				qcom,mdss-dsi-border-color = <0x0>;
				qcom,mdss-dsi-on-command = <0x29010000 0x2ff 0xee290100 0x2 0xfb012901 0x0 0x27c3129 0x1000000 0x2fb01
					0x29010000 0x2ff 0x1290100 0x2 0x75002901 0x0 0x276d429 0x1000000 0x27700
					0x29010000 0x278 0xe2290100 0x2 0x79002901 0x0 0x27af929 0x1000000 0x27b01
					0x29010000 0x27c 0xa290100 0x2 0x7d012901 0x0 0x27e1929 0x1000000 0x27f01
					0x29010000 0x280 0x26290100 0x2 0x81012901 0x0 0x2823329 0x1000000 0x2830
					0x29010000 0x284 0x3e290100 0x2 0x85012901 0x0 0x2864729 0x1000000 0x2870
					0x29010000 0x288 0x69290100 0x2 0x89012901 0x0 0x28a8629 0x1000000 0x28b0
					0x29010000 0x28c 0xb5290100 0x2 0x8d012901 0x0 0x28eda29 0x1000000 0x28f0
					0x29010000 0x290 0x17290100 0x2 0x91022901 0x0 0x2924829 0x1000000 0x2930
					0x29010000 0x294 0x49290100 0x2 0x95022901 0x0 0x2967629 0x1000000 0x2970
					0x29010000 0x298 0xa9290100 0x2 0x99022901 0x0 0x29ac929 0x1000000 0x29b0
					0x29010000 0x29c 0xf6290100 0x2 0x9d032901 0x0 0x29e1529 0x1000000 0x29f0
					0x29010000 0x2a0 0x3f290100 0x2 0xa2032901 0x0 0x2a34c29 0x1000000 0x2a40
					0x29010000 0x2a5 0x59290100 0x2 0xa6032901 0x0 0x2a76829 0x1000000 0x2a90
					0x29010000 0x2aa 0x7a290100 0x2 0xab032901 0x0 0x2ac8e29 0x1000000 0x2ad0
					0x29010000 0x2ae 0xa6290100 0x2 0xaf032901 0x0 0x2b0c229 0x1000000 0x2b10
					0x29010000 0x2b2 0xcb290100 0x2 0xb3002901 0x0 0x2b4d429 0x1000000 0x2b50
					0x29010000 0x2b6 0xe2290100 0x2 0xb7002901 0x0 0x2b8f929 0x1000000 0x2b90
					0x29010000 0x2ba 0xa290100 0x2 0xbb012901 0x0 0x2bc1929 0x1000000 0x2bd01
					0x29010000 0x2be 0x26290100 0x2 0xbf012901 0x0 0x2c03329 0x1000000 0x2c10
					0x29010000 0x2c2 0x3e290100 0x2 0xc3012901 0x0 0x2c44729 0x1000000 0x2c50
					0x29010000 0x2c6 0x69290100 0x2 0xc7012901 0x0 0x2c88629 0x1000000 0x2c90
					0x29010000 0x2ca 0xb5290100 0x2 0xcb012901 0x0 0x2ccda29 0x1000000 0x2cd0
					0x29010000 0x2ce 0x17290100 0x2 0xcf022901 0x0 0x2d04829 0x1000000 0x2d10
					0x29010000 0x2d2 0x49290100 0x2 0xd3022901 0x0 0x2d47629 0x1000000 0x2d50
					0x29010000 0x2d6 0xa9290100 0x2 0xd7022901 0x0 0x2d8c929 0x1000000 0x2d90
					0x29010000 0x2da 0xf6290100 0x2 0xdb032901 0x0 0x2dc1529 0x1000000 0x2dd0
					0x29010000 0x2de 0x3f290100 0x2 0xdf032901 0x0 0x2e04c29 0x1000000 0x2e10
					0x29010000 0x2e2 0x59290100 0x2 0xe3032901 0x0 0x2e46829 0x1000000 0x2e50
					0x29010000 0x2e6 0x7a290100 0x2 0xe7032901 0x0 0x2e88e29 0x1000000 0x2e90
					0x29010000 0x2ea 0xa6290100 0x2 0xeb032901 0x0 0x2ecc229 0x1000000 0x2ed0
					0x29010000 0x2ee 0xcb290100 0x2 0xef002901 0x0 0x2f02029 0x1000000 0x2f10
					0x29010000 0x2f2 0x36290100 0x2 0xf3002901 0x0 0x2f45729 0x1000000 0x2f50
					0x29010000 0x2f6 0x70290100 0x2 0xf7002901 0x0 0x2f88729 0x1000000 0x2f90
					0x29010000 0x2fa 0x9a290100 0x2 0xff022901 0x0 0x2fb0129 0x1000000 0x2000
					0x29010000 0x201 0xab290100 0x2 0x2002901 0x0 0x203bb29 0x1000000 0x20400
					0x29010000 0x205 0xc9290100 0x2 0x6002901 0x0 0x207f929 0x1000000 0x20801
					0x29010000 0x209 0x20290100 0x2 0xa012901 0x0 0x20b5f29 0x1000000 0x20c01
					0x29010000 0x20d 0x90290100 0x2 0xe012901 0x0 0x20fdf29 0x1000000 0x21002
					0x29010000 0x211 0x1c290100 0x2 0x12022901 0x0 0x2131d29 0x1000000 0x2140
					0x29010000 0x215 0x54290100 0x2 0x16022901 0x0 0x2178f29 0x1000000 0x2180
					0x29010000 0x219 0xb5290100 0x2 0x1a022901 0x0 0x21be829 0x1000000 0x21c0
					0x29010000 0x21d 0xb290100 0x2 0x1e032901 0x0 0x21f3929 0x1000000 0x22003
					0x29010000 0x221 0x46290100 0x2 0x22032901 0x0 0x2235529 0x1000000 0x2240
					0x29010000 0x225 0x64290100 0x2 0x26032901 0x0 0x2277829 0x1000000 0x2280
					0x29010000 0x229 0x8c290100 0x2 0x2a032901 0x0 0x22ba629 0x1000000 0x22d0
					0x29010000 0x22f 0xc2290100 0x2 0x30032901 0x0 0x231cb29 0x1000000 0x2320
					0x29010000 0x233 0x20290100 0x2 0x34002901 0x0 0x2353629 0x1000000 0x2360
					0x29010000 0x237 0x57290100 0x2 0x38002901 0x0 0x2397029 0x1000000 0x23a0
					0x29010000 0x23b 0x87290100 0x2 0x3d002901 0x0 0x23f9a29 0x1000000 0x2400
					0x29010000 0x241 0xab290100 0x2 0x42002901 0x0 0x243bb29 0x1000000 0x2440
					0x29010000 0x245 0xc9290100 0x2 0x46002901 0x0 0x247f929 0x1000000 0x2480
					0x29010000 0x249 0x20290100 0x2 0x4a012901 0x0 0x24b5f29 0x1000000 0x24c0
					0x29010000 0x24d 0x90290100 0x2 0x4e012901 0x0 0x24fdf29 0x1000000 0x2500
					0x29010000 0x251 0x1c290100 0x2 0x52022901 0x0 0x2531d29 0x1000000 0x2540
					0x29010000 0x255 0x54290100 0x2 0x56022901 0x0 0x2588f29 0x1000000 0x2590
					0x29010000 0x25a 0xb5290100 0x2 0x5b022901 0x0 0x25ce829 0x1000000 0x25d0
					0x29010000 0x25e 0xb290100 0x2 0x5f032901 0x0 0x2603929 0x1000000 0x26103
					0x29010000 0x262 0x46290100 0x2 0x63032901 0x0 0x2645529 0x1000000 0x2650
					0x29010000 0x266 0x64290100 0x2 0x67032901 0x0 0x2687829 0x1000000 0x2690
					0x29010000 0x26a 0x8c290100 0x2 0x6b032901 0x0 0x26ca629 0x1000000 0x26d0
					0x29010000 0x26e 0xc2290100 0x2 0x6f032901 0x0 0x270cb29 0x1000000 0x2710
					0x29010000 0x272 0xdd290100 0x2 0x73002901 0x0 0x274eb29 0x1000000 0x27501
					0x29010000 0x276 0x1290100 0x2 0x77012901 0x0 0x2781229 0x1000000 0x27901
					0x29010000 0x27a 0x21290100 0x2 0x7b012901 0x0 0x27c2d29 0x1000000 0x27d0
					0x29010000 0x27e 0x39290100 0x2 0x7f012901 0x0 0x2804429 0x1000000 0x2810
					0x29010000 0x282 0x4e290100 0x2 0x83012901 0x0 0x2846f29 0x1000000 0x2850
					0x29010000 0x286 0x8b290100 0x2 0x87012901 0x0 0x288b929 0x1000000 0x2890
					0x29010000 0x28a 0xde290100 0x2 0x8b022901 0x0 0x28c1a29 0x1000000 0x28d0
					0x29010000 0x28e 0x4a290100 0x2 0x8f022901 0x0 0x2904b29 0x1000000 0x2910
					0x29010000 0x292 0x78290100 0x2 0x93022901 0x0 0x294aa29 0x1000000 0x2950
					0x29010000 0x296 0xca290100 0x2 0x97022901 0x0 0x298f729 0x1000000 0x2990
					0x29010000 0x29a 0x16290100 0x2 0x9b032901 0x0 0x29c4029 0x1000000 0x29d03
					0x29010000 0x29e 0x4c290100 0x2 0x9f032901 0x0 0x2a05a29 0x1000000 0x2a20
					0x29010000 0x2a3 0x68290100 0x2 0xa4032901 0x0 0x2a57a29 0x1000000 0x2a60
					0x29010000 0x2a7 0x8e290100 0x2 0xa9032901 0x0 0x2aaa629 0x1000000 0x2ab0
					0x29010000 0x2ac 0xc2290100 0x2 0xad032901 0x0 0x2aecb29 0x1000000 0x2af0
					0x29010000 0x2b0 0xdd290100 0x2 0xb1002901 0x0 0x2b2eb29 0x1000000 0x2b30
					0x29010000 0x2b4 0x1290100 0x2 0xb5012901 0x0 0x2b61229 0x1000000 0x2b701
					0x29010000 0x2b8 0x21290100 0x2 0xb9012901 0x0 0x2ba2d29 0x1000000 0x2bb0
					0x29010000 0x2bc 0x39290100 0x2 0xbd012901 0x0 0x2be4429 0x1000000 0x2bf0
					0x29010000 0x2c0 0x4e290100 0x2 0xc1012901 0x0 0x2c26f29 0x1000000 0x2c30
					0x29010000 0x2c4 0x8b290100 0x2 0xc5012901 0x0 0x2c6b929 0x1000000 0x2c70
					0x29010000 0x2c8 0xde290100 0x2 0xc9022901 0x0 0x2ca1a29 0x1000000 0x2cb0
					0x29010000 0x2cc 0x4a290100 0x2 0xcd022901 0x0 0x2ce4b29 0x1000000 0x2cf0
					0x29010000 0x2d0 0x78290100 0x2 0xd1022901 0x0 0x2d2aa29 0x1000000 0x2d30
					0x29010000 0x2d4 0xca290100 0x2 0xd5022901 0x0 0x2d6f729 0x1000000 0x2d70
					0x29010000 0x2d8 0x16290100 0x2 0xd9032901 0x0 0x2da4029 0x1000000 0x2db0
					0x29010000 0x2dc 0x4c290100 0x2 0xdd032901 0x0 0x2de5a29 0x1000000 0x2df0
					0x29010000 0x2e0 0x68290100 0x2 0xe1032901 0x0 0x2e27a29 0x1000000 0x2e30
					0x29010000 0x2e4 0x8e290100 0x2 0xe5032901 0x0 0x2e6a629 0x1000000 0x2e70
					0x29010000 0x2e8 0xc2290100 0x2 0xe9032901 0x0 0x2eacb29 0x1000000 0x2c90
					0x29010000 0x2ca 0xcb290100 0x2 0xcb022901 0x0 0x2cc0529 0x1000000 0x2cd0
					0x29010000 0x2ce 0x7290100 0x2 0xcf022901 0x0 0x2d04729 0x1000000 0x2d102
					0x29010000 0x2d2 0x82290100 0x2 0xd3022901 0x0 0x2d4ab29 0x1000000 0x2d50
					0x29010000 0x2d6 0xdc290100 0x2 0xd7032901 0x0 0x2d80129 0x1000000 0x2d90
					0x29010000 0x2da 0x3a290100 0x2 0xdb032901 0x0 0x2dc5629 0x1000000 0x2dd0
					0x29010000 0x2de 0x6d290100 0x2 0xdf032901 0x0 0x2e08929 0x1000000 0x2e10
					0x29010000 0x2e2 0xa3290100 0x2 0xe3032901 0x0 0x2e4c929 0x1000000 0x2e50
					0x29010000 0x2e6 0xdd290100 0x2 0xe7032901 0x0 0x2e8f529 0x1000000 0x2e90
					0x29010000 0x2ea 0xff290100 0x2 0xfb012901 0x0 0x2ff0129 0x1000000 0x2000
					0x29010000 0x201 0x55290100 0x2 0x2402901 0x0 0x2055029 0x1000000 0x2064a
					0x29010000 0x207 0x29290100 0x2 0x80c2901 0x0 0x20b8729 0x1000000 0x20c87
					0x29010000 0x20e 0xb0290100 0x2 0xfb32901 0x0 0x2111029 0x1000000 0x21210
					0x29010000 0x213 0x3290100 0x2 0x144a2901 0x0 0x2151229 0x1000000 0x21612
					0x29010000 0x218 0x290100 0x2 0x19772901 0x0 0x21a5529 0x1000000 0x21b13 
					0x29010000 0x21c 0x290100 0x2 0x1d002901 0x0 0x21e0029 0x1000000 0x21f00 
					0x29010000 0x258 0x82290100 0x2 0x59022901 0x0 0x25a0229 0x1000000 0x25b02
					0x29010000 0x25c 0x82290100 0x2 0x5d822901 0x0 0x25e0229 0x1000000 0x25f0
					0x29010000 0x272 0x31290100 0x2 0xfb012901 0x0 0x2ff0529 0x1000000 0x2000
					0x29010000 0x201 0xb290100 0x2 0x20c2901 0x0 0x2030929 0x1000000 0x2040a
					0x29010000 0x205 0x290100 0x2 0x60f2901 0x0 0x2071029 0x1000000 0x2081a
					0x29010000 0x209 0x290100 0x2 0xa002901 0x0 0x20b0029 0x1000000 0x20c00
					0x29010000 0x20d 0x13290100 0x2 0xe152901 0x0 0x20f1729 0x1000000 0x21001
					0x29010000 0x211 0xb290100 0x2 0x120c2901 0x0 0x2130929 0x1000000 0x2140a
					0x29010000 0x215 0x290100 0x2 0x160f2901 0x0 0x2171029 0x1000000 0x2181a
					0x29010000 0x219 0x290100 0x2 0x1a002901 0x0 0x21b0029 0x1000000 0x21c00
					0x29010000 0x21d 0x13290100 0x2 0x1e152901 0x0 0x21f1729 0x1000000 0x22000
					0x29010000 0x221 0x1290100 0x2 0x22002901 0x0 0x2234029 0x1000000 0x22440
					0x29010000 0x225 0x6d290100 0x2 0x29db2901 0x0 0x22a2a29 0x1000000 0x22b0
					0x29010000 0x2b6 0x89290100 0x2 0xb7142901 0x0 0x2b80529 0x1000000 0x24b0
					0x29010000 0x24c 0x11290100 0x2 0x4d102901 0x0 0x24e0129 0x1000000 0x24f0
					0x29010000 0x250 0x10290100 0x2 0x51002901 0x0 0x2520029 0x1000000 0x2530
					0x29010000 0x254 0x1290100 0x2 0x556d2901 0x0 0x25b4429 0x1000000 0x25c00
					0x29010000 0x25f 0x74290100 0x2 0x60752901 0x0 0x263ff29 0x1000000 0x2640
					0x29010000 0x267 0x4290100 0x2 0x68042901 0x0 0x26c0029 0x1000000 0x27a80
					0x29010000 0x27b 0x91290100 0x2 0x7cd82901 0x0 0x27d6029 0x1000000 0x27f1
					0x29010000 0x280 0x290100 0x2 0x83002901 0x0 0x2930829 0x1000000 0x2940a
					0x29010000 0x28a 0x33290100 0x2 0xa40f2901 0x0 0x29b0f29 0x1000000 0x2fb01
					0x29010000 0x2ff 0x1290100 0x2 0x150f2901 0x0 0x2160f29 0x1000000 0x21b1b
					0x29010000 0x21c 0xf7290100 0x2 0x600f2901 0x0 0x2588229 0x1000000 0x2590
					0x29010000 0x25a 0x2290100 0x2 0x5b002901 0x0 0x25c8229 0x1000000 0x25d80
					0x29010000 0x25e 0x2290100 0x2 0x5f002901 0x0 0x2660129 0x1000000 0x2fb01
					0x29010000 0x2ff 0x5290100 0x2 0x85052901 0x0 0x2a60429 0x1000000 0x2fb01
					0x29010000 0x2ff 0xff290100 0x2 0x4f032901 0x0 0x2fb0129 0x1000000 0x2ff0
					0x29010000 0x2d3 0x6290100 0x2 0xd4042901 0x0 0x2350029 0x1000000 0x251ff
					0x29010000 0x253 0x2c290100 0x2 0x55002901 0x7800 0x2110029 0x1000000 0x22900>;
				qcom,mdss-dsi-off-command = [05 01 00 00 32 00 02 28 00 05 01 00 00 78 00 02 10 00];
				qcom,mdss-dsi-on-command-state = "dsi_lp_mode";
				qcom,mdss-dsi-off-command-state = "dsi_hs_mode";
				qcom,mdss-dsi-panel-status-command = [06 01 00 01 05 00 02 0a 08];
				qcom,mdss-dsi-panel-status-command-state = "dsi_lp_mode";
				qcom,mdss-dsi-panel-status-check-mode = "reg_read_nt35596";
				qcom,mdss-dsi-panel-status-value = <0x9c>;
				qcom,mdss-dsi-h-sync-pulse = <0x1>;
				qcom,mdss-dsi-traffic-mode = "burst_mode";
				qcom,mdss-dsi-lane-map = "lane_map_0123";
				qcom,mdss-dsi-bllp-eof-power-mode;
				qcom,mdss-dsi-bllp-power-mode;
				qcom,mdss-dsi-lane-0-state;
				qcom,mdss-dsi-lane-1-state;
				qcom,mdss-dsi-lane-2-state;
				qcom,mdss-dsi-lane-3-state;
				qcom,mdss-dsi-panel-timings = <0x9e433700 0x60583945 0x5b030400>;
				qcom,mdss-dsi-t-clk-post = <0x1e>;
				qcom,mdss-dsi-t-clk-pre = <0x38>;
				qcom,mdss-dsi-bl-min-level = <0x1>;
				qcom,mdss-dsi-bl-max-level = <0xff>;
				qcom,mdss-dsi-dma-trigger = "trigger_sw";
				qcom,mdss-dsi-mdp-trigger = "none";
				qcom,mdss-dsi-bl-pmic-control-type = "bl_ctrl_dcs";
				qcom,mdss-dsi-reset-sequence = <0x1 0x14 0x0 0x14 0x1 0x14>;
				qcom,cont-splash-enabled;
				qcom,esd-check-enabled;
				qcom,mdss-dsi-pan-enable-dynamic-fps;
				qcom,mdss-dsi-pan-fps-update = "dfps_immediate_porch_mode";
			};
};
