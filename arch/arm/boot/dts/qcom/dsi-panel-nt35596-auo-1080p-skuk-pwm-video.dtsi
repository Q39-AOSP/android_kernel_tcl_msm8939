/* Copyright (c) 2017, The Linux Foundation. All rights reserved.
 *
 * This program is free software; you can redistribute it and/or modify
 * it under the terms of the GNU General Public License version 2 and
 * only version 2 as published by the Free Software Foundation.
 *
 * This program is distributed in the hope that it will be useful,
 * but WITHOUT ANY WARRANTY; without even the implied warranty of
 * MERCHANTABILITY or FITNESS FOR A PARTICULAR PURPOSE.  See the
 * GNU General Public License for more details.
 */
 
&mdss_mdp {
	dsi_nt35596_auo_1080p_skuk_pwm_video: qcom,mdss_dsi_nt35596_auo_1080p_skuk_pwm_video {
				qcom,mdss-dsi-panel-name = "nt35596 auo 1080p pwm video mode dsi panel skuk";
				qcom,mdss-dsi-panel-controller = <&mdss_dsi0>;
				qcom,mdss-dsi-panel-type = "dsi_video_mode";
				qcom,mdss-dsi-panel-destination = "display_1";
				qcom,mdss-dsi-panel-framerate = <60>;
				qcom,mdss-dsi-virtual-channel-id = <0>;
				qcom,mdss-dsi-stream = <0>;
				qcom,mdss-dsi-panel-width = <1080>;
				qcom,mdss-dsi-panel-height = <1920>;
				qcom,mdss-dsi-h-front-porch = <104>;
				qcom,mdss-dsi-h-back-porch = <56>;
				qcom,mdss-dsi-h-pulse-width = <20>;
				qcom,mdss-dsi-h-sync-skew = <0>;
				qcom,mdss-dsi-v-back-porch = <3>;
				qcom,mdss-dsi-v-front-porch = <3>;
				qcom,mdss-dsi-v-pulse-width = <2>;
				qcom,mdss-dsi-bpp = <24>;
				qcom,mdss-dsi-color-order = "rgb_swap_rgb";
				qcom,mdss-dsi-underflow-color = <0xff>;
				qcom,mdss-dsi-border-color = <0>;
				qcom,mdss-dsi-on-command = [29 01 00 00 00 00 02 ff ee
			29 01 00 00 00 00 02 7c 31
			29 01 00 00 00 00 02 ff 01
			29 01 00 00 00 00 02 fb 01
			29 01 00 00 00 00 02 75 00
			29 01 00 00 00 00 02 76 79
			29 01 00 00 00 00 02 77 00
			29 01 00 00 00 00 02 78 89
			29 01 00 00 00 00 02 79 00
			29 01 00 00 00 00 02 7a a2
			29 01 00 00 00 00 02 7b 00
			29 01 00 00 00 00 02 7c b5
			29 01 00 00 00 00 02 7d 00
			29 01 00 00 00 00 02 7e f5
			29 01 00 00 00 00 02 7f 01
			29 01 00 00 00 00 02 80 04
			29 01 00 00 00 00 02 81 01
			29 01 00 00 00 00 02 82 11
			29 01 00 00 00 00 02 83 01
			29 01 00 00 00 00 02 84 1d
			29 01 00 00 00 00 02 85 01
			29 01 00 00 00 00 02 86 28
			29 01 00 00 00 00 02 87 01
			29 01 00 00 00 00 02 88 4d
			29 01 00 00 00 00 02 89 01
			29 01 00 00 00 00 02 8a 6d
			29 01 00 00 00 00 02 8b 01
			29 01 00 00 00 00 02 8c a0
			29 01 00 00 00 00 02 8d 01
			29 01 00 00 00 00 02 8e c8
			29 01 00 00 00 00 02 8f 02
			29 01 00 00 00 00 02 90 09
			29 01 00 00 00 00 02 91 02
			29 01 00 00 00 00 02 92 3d
			29 01 00 00 00 00 02 93 02
			29 01 00 00 00 00 02 94 3e
			29 01 00 00 00 00 02 95 02
			29 01 00 00 00 00 02 96 6e
			29 01 00 00 00 00 02 97 02
			29 01 00 00 00 00 02 98 a3
			29 01 00 00 00 00 02 99 02
			29 01 00 00 00 00 02 9a c4
			29 01 00 00 00 00 02 9b 02
			29 01 00 00 00 00 02 9c f3
			29 01 00 00 00 00 02 9d 03
			29 01 00 00 00 00 02 9e 13
			29 01 00 00 00 00 02 9f 03
			29 01 00 00 00 00 02 a0 3e
			29 01 00 00 00 00 02 a2 03
			29 01 00 00 00 00 02 a3 4a
			29 01 00 00 00 00 02 a4 03
			29 01 00 00 00 00 02 a5 58
			29 01 00 00 00 00 02 a6 03
			29 01 00 00 00 00 02 a7 67
			29 01 00 00 00 00 02 a9 03
			29 01 00 00 00 00 02 aa 7a
			29 01 00 00 00 00 02 ab 03
			29 01 00 00 00 00 02 ac 8d
			29 01 00 00 00 00 02 ad 03
			29 01 00 00 00 00 02 ae a6
			29 01 00 00 00 00 02 af 03
			29 01 00 00 00 00 02 b0 c2
			29 01 00 00 00 00 02 b1 03
			29 01 00 00 00 00 02 b2 cb
			29 01 00 00 00 00 02 b3 00
			29 01 00 00 00 00 02 b4 79
			29 01 00 00 00 00 02 b5 00
			29 01 00 00 00 00 02 b6 89
			29 01 00 00 00 00 02 b7 00
			29 01 00 00 00 00 02 b8 a2
			29 01 00 00 00 00 02 b9 00
			29 01 00 00 00 00 02 ba b5
			29 01 00 00 00 00 02 bb 00
			29 01 00 00 00 00 02 bc f5
			29 01 00 00 00 00 02 bd 01
			29 01 00 00 00 00 02 be 04
			29 01 00 00 00 00 02 bf 01
			29 01 00 00 00 00 02 c0 11
			29 01 00 00 00 00 02 c1 01
			29 01 00 00 00 00 02 c2 1d
			29 01 00 00 00 00 02 c3 01
			29 01 00 00 00 00 02 c4 28
			29 01 00 00 00 00 02 c5 01
			29 01 00 00 00 00 02 c6 4d
			29 01 00 00 00 00 02 c7 01
			29 01 00 00 00 00 02 c8 6d
			29 01 00 00 00 00 02 c9 01
			29 01 00 00 00 00 02 ca a0
			29 01 00 00 00 00 02 cb 01
			29 01 00 00 00 00 02 cc c8
			29 01 00 00 00 00 02 cd 02
			29 01 00 00 00 00 02 ce 09
			29 01 00 00 00 00 02 cf 02
			29 01 00 00 00 00 02 d0 3d
			29 01 00 00 00 00 02 d1 02
			29 01 00 00 00 00 02 d2 3e
			29 01 00 00 00 00 02 d3 02
			29 01 00 00 00 00 02 d4 6e
			29 01 00 00 00 00 02 d5 02
			29 01 00 00 00 00 02 d6 a3
			29 01 00 00 00 00 02 d7 02
			29 01 00 00 00 00 02 d8 c4
			29 01 00 00 00 00 02 d9 02
			29 01 00 00 00 00 02 da f3
			29 01 00 00 00 00 02 db 03
			29 01 00 00 00 00 02 dc 13
			29 01 00 00 00 00 02 dd 03
			29 01 00 00 00 00 02 de 3e
			29 01 00 00 00 00 02 df 03
			29 01 00 00 00 00 02 e0 4a
			29 01 00 00 00 00 02 e1 03
			29 01 00 00 00 00 02 e2 58
			29 01 00 00 00 00 02 e3 03
			29 01 00 00 00 00 02 e4 67
			29 01 00 00 00 00 02 e5 03
			29 01 00 00 00 00 02 e6 7a
			29 01 00 00 00 00 02 e7 03
			29 01 00 00 00 00 02 e8 8d
			29 01 00 00 00 00 02 e9 03
			29 01 00 00 00 00 02 ea a6
			29 01 00 00 00 00 02 eb 03
			29 01 00 00 00 00 02 ec c2
			29 01 00 00 00 00 02 ed 03
			29 01 00 00 00 00 02 ee cb
			29 01 00 00 00 00 02 ef 00
			29 01 00 00 00 00 02 f0 49
			29 01 00 00 00 00 02 f1 00
			29 01 00 00 00 00 02 f2 5b
			29 01 00 00 00 00 02 f3 00
			29 01 00 00 00 00 02 f4 77
			29 01 00 00 00 00 02 f5 00
			29 01 00 00 00 00 02 f6 8c
			29 01 00 00 00 00 02 f7 00
			29 01 00 00 00 00 02 f8 d0
			29 01 00 00 00 00 02 f9 00
			29 01 00 00 00 00 02 fa e0
			29 01 00 00 00 00 02 ff 02
			29 01 00 00 00 00 02 fb 01
			29 01 00 00 00 00 02 00 00
			29 01 00 00 00 00 02 01 ef
			29 01 00 00 00 00 02 02 00
			29 01 00 00 00 00 02 03 fc
			29 01 00 00 00 00 02 04 01
			29 01 00 00 00 00 02 05 08
			29 01 00 00 00 00 02 06 01
			29 01 00 00 00 00 02 07 31
			29 01 00 00 00 00 02 08 01
			29 01 00 00 00 00 02 09 53
			29 01 00 00 00 00 02 0a 01 
			29 01 00 00 00 00 02 0b 8a
			29 01 00 00 00 00 02 0c 01 
			29 01 00 00 00 00 02 0d b5
			29 01 00 00 00 00 02 0e 01
			29 01 00 00 00 00 02 0f fb
			29 01 00 00 00 00 02 10 02
			29 01 00 00 00 00 02 11 32
			29 01 00 00 00 00 02 12 02
			29 01 00 00 00 00 02 13 33
			29 01 00 00 00 00 02 14 02
			29 01 00 00 00 00 02 15 65
			29 01 00 00 00 00 02 16 02
			29 01 00 00 00 00 02 17 9c
			29 01 00 00 00 00 02 18 02
			29 01 00 00 00 00 02 19 bf
			29 01 00 00 00 00 02 1a 02
			29 01 00 00 00 00 02 1b ef
			29 01 00 00 00 00 02 1c 03
			29 01 00 00 00 00 02 1d 10
			29 01 00 00 00 00 02 1e 03
			29 01 00 00 00 00 02 1f 3c
			29 01 00 00 00 00 02 20 03
			29 01 00 00 00 00 02 21 49
			29 01 00 00 00 00 02 22 03
			29 01 00 00 00 00 02 23 57
			29 01 00 00 00 00 02 24 03
			29 01 00 00 00 00 02 25 66
			29 01 00 00 00 00 02 26 03
			29 01 00 00 00 00 02 27 79
			29 01 00 00 00 00 02 28 03
			29 01 00 00 00 00 02 29 8d
			29 01 00 00 00 00 02 2a 03
			29 01 00 00 00 00 02 2b a6
			29 01 00 00 00 00 02 2d 03
			29 01 00 00 00 00 02 2f c2
			29 01 00 00 00 00 02 30 03
			29 01 00 00 00 00 02 31 cb
			29 01 00 00 00 00 02 32 00
			29 01 00 00 00 00 02 33 49
			29 01 00 00 00 00 02 34 00
			29 01 00 00 00 00 02 35 5b
			29 01 00 00 00 00 02 36 00
			29 01 00 00 00 00 02 37 77
			29 01 00 00 00 00 02 38 00
			29 01 00 00 00 00 02 39 8c
			29 01 00 00 00 00 02 3a 00
			29 01 00 00 00 00 02 3b d0
			29 01 00 00 00 00 02 3d 00
			29 01 00 00 00 00 02 3f e0
			29 01 00 00 00 00 02 40 00
			29 01 00 00 00 00 02 41 ef
			29 01 00 00 00 00 02 42 00
			29 01 00 00 00 00 02 43 fc
			29 01 00 00 00 00 02 44 01
			29 01 00 00 00 00 02 45 08
			29 01 00 00 00 00 02 46 01
			29 01 00 00 00 00 02 47 31
			29 01 00 00 00 00 02 48 01
			29 01 00 00 00 00 02 49 53
			29 01 00 00 00 00 02 4a 01
			29 01 00 00 00 00 02 4b 8a
			29 01 00 00 00 00 02 4c 01
			29 01 00 00 00 00 02 4d b5
			29 01 00 00 00 00 02 4e 01
			29 01 00 00 00 00 02 4f fb
			29 01 00 00 00 00 02 50 02
			29 01 00 00 00 00 02 51 32
			29 01 00 00 00 00 02 52 02
			29 01 00 00 00 00 02 53 33
			29 01 00 00 00 00 02 54 02
			29 01 00 00 00 00 02 55 65
			29 01 00 00 00 00 02 56 02
			29 01 00 00 00 00 02 58 9c
			29 01 00 00 00 00 02 59 02
			29 01 00 00 00 00 02 5a bf
			29 01 00 00 00 00 02 5b 02
			29 01 00 00 00 00 02 5c ef
			29 01 00 00 00 00 02 5d 03
			29 01 00 00 00 00 02 5e 10
			29 01 00 00 00 00 02 5f 03
			29 01 00 00 00 00 02 60 3c
			29 01 00 00 00 00 02 61 03
			29 01 00 00 00 00 02 62 49
			29 01 00 00 00 00 02 63 03
			29 01 00 00 00 00 02 64 57
			29 01 00 00 00 00 02 65 03
			29 01 00 00 00 00 02 66 66
			29 01 00 00 00 00 02 67 03
			29 01 00 00 00 00 02 68 79
			29 01 00 00 00 00 02 69 03
			29 01 00 00 00 00 02 6a 8d
			29 01 00 00 00 00 02 6b 03
			29 01 00 00 00 00 02 6c a6
			29 01 00 00 00 00 02 6d 03
			29 01 00 00 00 00 02 6e c2
			29 01 00 00 00 00 02 6f 03
			29 01 00 00 00 00 02 70 cb
			29 01 00 00 00 00 02 71 00
			29 01 00 00 00 00 02 72 79
			29 01 00 00 00 00 02 73 00
			29 01 00 00 00 00 02 74 89
			29 01 00 00 00 00 02 75 00
			29 01 00 00 00 00 02 76 a2
			29 01 00 00 00 00 02 77 00
			29 01 00 00 00 00 02 78 b5
			29 01 00 00 00 00 02 79 00
			29 01 00 00 00 00 02 7a f5
			29 01 00 00 00 00 02 7b 01
			29 01 00 00 00 00 02 7c 04
			29 01 00 00 00 00 02 7d 01
			29 01 00 00 00 00 02 7e 11
			29 01 00 00 00 00 02 7f 01
			29 01 00 00 00 00 02 80 1d
			29 01 00 00 00 00 02 81 01
			29 01 00 00 00 00 02 82 28
			29 01 00 00 00 00 02 83 01
			29 01 00 00 00 00 02 84 4d
			29 01 00 00 00 00 02 85 01
			29 01 00 00 00 00 02 86 6d
			29 01 00 00 00 00 02 87 01
			29 01 00 00 00 00 02 88 a0
			29 01 00 00 00 00 02 89 01
			29 01 00 00 00 00 02 8a c8
			29 01 00 00 00 00 02 8b 02
			29 01 00 00 00 00 02 8c 09
			29 01 00 00 00 00 02 8d 02
			29 01 00 00 00 00 02 8e 3d
			29 01 00 00 00 00 02 8f 02
			29 01 00 00 00 00 02 90 3e
			29 01 00 00 00 00 02 91 02
			29 01 00 00 00 00 02 92 6e
			29 01 00 00 00 00 02 93 02
			29 01 00 00 00 00 02 94 a3
			29 01 00 00 00 00 02 95 02
			29 01 00 00 00 00 02 96 c4
			29 01 00 00 00 00 02 97 02
			29 01 00 00 00 00 02 98 f3
			29 01 00 00 00 00 02 99 03
			29 01 00 00 00 00 02 9a 13
			29 01 00 00 00 00 02 9b 03
			29 01 00 00 00 00 02 9c 3e
			29 01 00 00 00 00 02 9d 03
			29 01 00 00 00 00 02 9e 4a
			29 01 00 00 00 00 02 9f 03
			29 01 00 00 00 00 02 a0 58
			29 01 00 00 00 00 02 a2 03
			29 01 00 00 00 00 02 a3 67
			29 01 00 00 00 00 02 a4 03
			29 01 00 00 00 00 02 a5 7a
			29 01 00 00 00 00 02 a6 03
			29 01 00 00 00 00 02 a7 8d
			29 01 00 00 00 00 02 a9 03
			29 01 00 00 00 00 02 aa a6
			29 01 00 00 00 00 02 ab 03
			29 01 00 00 00 00 02 ac c2
			29 01 00 00 00 00 02 ad 03
			29 01 00 00 00 00 02 ae cb
			29 01 00 00 00 00 02 af 00
			29 01 00 00 00 00 02 b0 79
			29 01 00 00 00 00 02 b1 00
			29 01 00 00 00 00 02 b2 89
			29 01 00 00 00 00 02 b3 00
			29 01 00 00 00 00 02 b4 a2
			29 01 00 00 00 00 02 b5 00
			29 01 00 00 00 00 02 b6 b5
			29 01 00 00 00 00 02 b7 00
			29 01 00 00 00 00 02 b8 f5
			29 01 00 00 00 00 02 b9 01
			29 01 00 00 00 00 02 ba 04
			29 01 00 00 00 00 02 bb 01
			29 01 00 00 00 00 02 bc 11
			29 01 00 00 00 00 02 bd 01
			29 01 00 00 00 00 02 be 1d
			29 01 00 00 00 00 02 bf 01
			29 01 00 00 00 00 02 c0 28
			29 01 00 00 00 00 02 c1 01
			29 01 00 00 00 00 02 c2 4d
			29 01 00 00 00 00 02 c3 01
			29 01 00 00 00 00 02 c4 6d
			29 01 00 00 00 00 02 c5 01
			29 01 00 00 00 00 02 c6 a0
			29 01 00 00 00 00 02 c7 01
			29 01 00 00 00 00 02 c8 c8
			29 01 00 00 00 00 02 c9 02
			29 01 00 00 00 00 02 ca 09
			29 01 00 00 00 00 02 cb 02
			29 01 00 00 00 00 02 cc 3d
			29 01 00 00 00 00 02 cd 02
			29 01 00 00 00 00 02 ce 3e
			29 01 00 00 00 00 02 cf 02
			29 01 00 00 00 00 02 d0 6e
			29 01 00 00 00 00 02 d1 02
			29 01 00 00 00 00 02 d2 a3
			29 01 00 00 00 00 02 d3 02
			29 01 00 00 00 00 02 d4 c4
			29 01 00 00 00 00 02 d5 02
			29 01 00 00 00 00 02 d6 f3
			29 01 00 00 00 00 02 d7 03
			29 01 00 00 00 00 02 d8 13
			29 01 00 00 00 00 02 d9 03
			29 01 00 00 00 00 02 da 3e
			29 01 00 00 00 00 02 db 03
			29 01 00 00 00 00 02 dc 4a
			29 01 00 00 00 00 02 dd 03
			29 01 00 00 00 00 02 de 58
			29 01 00 00 00 00 02 df 03
			29 01 00 00 00 00 02 e0 67
			29 01 00 00 00 00 02 e1 03
			29 01 00 00 00 00 02 e2 7a
			29 01 00 00 00 00 02 e3 03
			29 01 00 00 00 00 02 e4 8d
			29 01 00 00 00 00 02 e5 03
			29 01 00 00 00 00 02 e6 a6
			29 01 00 00 00 00 02 e7 03
			29 01 00 00 00 00 02 e8 c2
			29 01 00 00 00 00 02 e9 03
			29 01 00 00 00 00 02 ea cb
			29 01 00 00 00 00 02 fb 01
			29 01 00 00 00 00 02 ff 01
			29 01 00 00 00 00 02 00 01
			29 01 00 00 00 00 02 01 55
			29 01 00 00 00 00 02 02 40
			29 01 00 00 00 00 02 05 50
			29 01 00 00 00 00 02 06 4a
			29 01 00 00 00 00 02 07 29
			29 01 00 00 00 00 02 08 0c
			29 01 00 00 00 00 02 0b 87
			29 01 00 00 00 00 02 0c 87
			29 01 00 00 00 00 02 0e b0
			29 01 00 00 00 00 02 0f b3
			29 01 00 00 00 00 02 11 10
			29 01 00 00 00 00 02 12 10
			29 01 00 00 00 00 02 13 03
			29 01 00 00 00 00 02 14 4a
			29 01 00 00 00 00 02 15 12
			29 01 00 00 00 00 02 16 12
			29 01 00 00 00 00 02 18 00
			29 01 00 00 00 00 02 19 77
			29 01 00 00 00 00 02 1a 55
			29 01 00 00 00 00 02 1b 13
			29 01 00 00 00 00 02 1c 00
			29 01 00 00 00 00 02 1d 00
			29 01 00 00 00 00 02 1e 00
			29 01 00 00 00 00 02 1f 00
			29 01 00 00 00 00 02 58 82
			29 01 00 00 00 00 02 59 02
			29 01 00 00 00 00 02 5a 02
			29 01 00 00 00 00 02 5b 02
			29 01 00 00 00 00 02 5c 82
			29 01 00 00 00 00 02 5d 82
			29 01 00 00 00 00 02 5e 02
			29 01 00 00 00 00 02 5f 02
			29 01 00 00 00 00 02 72 31
			29 01 00 00 00 00 02 fb 01
			29 01 00 00 00 00 02 ff 05
			29 01 00 00 00 00 02 00 01
			29 01 00 00 00 00 02 01 0b
			29 01 00 00 00 00 02 02 0c
			29 01 00 00 00 00 02 03 09
			29 01 00 00 00 00 02 04 0a
			29 01 00 00 00 00 02 05 00
			29 01 00 00 00 00 02 06 0f
			29 01 00 00 00 00 02 07 10
			29 01 00 00 00 00 02 08 1a
			29 01 00 00 00 00 02 09 00
			29 01 00 00 00 00 02 0a 00
			29 01 00 00 00 00 02 0b 00
			29 01 00 00 00 00 02 0c 00
			29 01 00 00 00 00 02 0d 13
			29 01 00 00 00 00 02 0e 15
			29 01 00 00 00 00 02 0f 17
			29 01 00 00 00 00 02 10 01
			29 01 00 00 00 00 02 11 0b
			29 01 00 00 00 00 02 12 0c
			29 01 00 00 00 00 02 13 09
			29 01 00 00 00 00 02 14 0a
			29 01 00 00 00 00 02 15 00
			29 01 00 00 00 00 02 16 0f
			29 01 00 00 00 00 02 17 10
			29 01 00 00 00 00 02 18 1a
			29 01 00 00 00 00 02 19 00
			29 01 00 00 00 00 02 1a 00
			29 01 00 00 00 00 02 1b 00
			29 01 00 00 00 00 02 1c 00
			29 01 00 00 00 00 02 1d 13
			29 01 00 00 00 00 02 1e 15
			29 01 00 00 00 00 02 1f 17
			29 01 00 00 00 00 02 20 00
			29 01 00 00 00 00 02 21 01
			29 01 00 00 00 00 02 22 00
			29 01 00 00 00 00 02 23 40
			29 01 00 00 00 00 02 24 40
			29 01 00 00 00 00 02 25 6d
			29 01 00 00 00 00 02 29 d8
			29 01 00 00 00 00 02 2a 2a
			29 01 00 00 00 00 02 2b 00
			29 01 00 00 00 00 02 b6 89
			29 01 00 00 00 00 02 b7 14
			29 01 00 00 00 00 02 b8 05
			29 01 00 00 00 00 02 4b 04
			29 01 00 00 00 00 02 4c 11
			29 01 00 00 00 00 02 4d 10
			29 01 00 00 00 00 02 4e 01
			29 01 00 00 00 00 02 4f 01
			29 01 00 00 00 00 02 50 10
			29 01 00 00 00 00 02 51 00
			29 01 00 00 00 00 02 52 00
			29 01 00 00 00 00 02 53 08
			29 01 00 00 00 00 02 54 01
			29 01 00 00 00 00 02 55 6d
			29 01 00 00 00 00 02 5b 44
			29 01 00 00 00 00 02 5c 00
			29 01 00 00 00 00 02 5f 74
			29 01 00 00 00 00 02 60 75
			29 01 00 00 00 00 02 63 ff
			29 01 00 00 00 00 02 64 00
			29 01 00 00 00 00 02 67 04
			29 01 00 00 00 00 02 68 04
			29 01 00 00 00 00 02 6c 00
			29 01 00 00 00 00 02 7a 80
			29 01 00 00 00 00 02 7b 91
			29 01 00 00 00 00 02 7c d8
			29 01 00 00 00 00 02 7d 60
			29 01 00 00 00 00 02 7f 15
			29 01 00 00 00 00 02 80 00
			29 01 00 00 00 00 02 83 00
			29 01 00 00 00 00 02 93 08
			29 01 00 00 00 00 02 94 0a
			29 01 00 00 00 00 02 8a 33
			29 01 00 00 00 00 02 a4 0f
			29 01 00 00 00 00 02 9b 0f
			29 01 00 00 00 00 02 fb 01
			29 01 00 00 00 00 02 ff 01
			29 01 00 00 00 00 02 15 0f
			29 01 00 00 00 00 02 16 0f
			29 01 00 00 00 00 02 1b 1b
			29 01 00 00 00 00 02 1c f7
			29 01 00 00 00 00 02 60 0f
			29 01 00 00 00 00 02 58 82
			29 01 00 00 00 00 02 59 00
			29 01 00 00 00 00 02 5a 02
			29 01 00 00 00 00 02 5b 00
			29 01 00 00 00 00 02 5c 82
			29 01 00 00 00 00 02 5d 80
			29 01 00 00 00 00 02 5e 02
			29 01 00 00 00 00 02 5f 00
			29 01 00 00 00 00 02 66 01
			29 01 00 00 00 00 02 fb 01
			29 01 00 00 00 00 02 ff 05
			29 01 00 00 00 00 02 85 05
			29 01 00 00 00 00 02 a6 04
			29 01 00 00 00 00 02 fb 01
			29 01 00 00 00 00 02 ff ff
			29 01 00 00 00 00 02 4f 03
			29 01 00 00 00 00 02 fb 01
			29 01 00 00 00 00 02 ff 00
			29 01 00 00 00 00 02 d3 06
			29 01 00 00 00 00 02 d4 04
			29 01 00 00 00 00 02 35 00
			29 01 00 00 78 00 02 11 00
			29 01 00 00 00 00 02 29 00];
				qcom,mdss-dsi-off-command = [05 01 00 00 32 00 02 28 00
							05 01 00 00 78 00 02 10 00];
				qcom,mdss-dsi-on-command-state = "dsi_lp_mode";
				qcom,mdss-dsi-off-command-state = "dsi_hs_mode";
				qcom,mdss-dsi-panel-status-command = [06 01 00 01 05 00 02 0a 08];
				qcom,mdss-dsi-panel-status-command-state = "dsi_lp_mode";
				qcom,mdss-dsi-panel-status-check-mode = "reg_read_nt35596";
				qcom,mdss-dsi-panel-status-value = <156>;
				qcom,mdss-dsi-h-sync-pulse = <1>;
				qcom,mdss-dsi-traffic-mode = "burst_mode";
				qcom,mdss-dsi-lane-map = "lane_map_0123";
				qcom,mdss-dsi-bllp-eof-power-mode;
				qcom,mdss-dsi-bllp-power-mode;
				qcom,mdss-dsi-lane-0-state;
				qcom,mdss-dsi-lane-1-state;
				qcom,mdss-dsi-lane-2-state;
				qcom,mdss-dsi-lane-3-state;
				qcom,mdss-dsi-panel-timings = [9e 43 37 00 60 58 39 45 5b 03 04 00];
				qcom,mdss-dsi-t-clk-post = <0x1e>;
				qcom,mdss-dsi-t-clk-pre = <0x38>;
				qcom,mdss-dsi-bl-min-level = <1>;
				qcom,mdss-dsi-bl-max-level = <255>;
				qcom,mdss-dsi-dma-trigger = "trigger_sw";
				qcom,mdss-dsi-mdp-trigger = "none";
				qcom,mdss-dsi-bl-pmic-control-type = "bl_ctrl_pwm";
				qcom,mdss-dsi-bl-pmic-pwm-frequency = <50>;
				qcom,mdss-dsi-bl-pmic-bank-select = <0>;
				qcom,mdss-dsi-pwm-gpio = <108 4 0>;
				qcom,mdss-dsi-reset-sequence = <0 20>,<0 40>,<1 20>;
				qcom,mdss-pan-physical-width-dimension = <62>;
				qcom,mdss-pan-physical-height-dimension = <110>;
				qcom,cont-splash-enabled;
				qcom,esd-check-enabled;
				qcom,mdss-dsi-pan-enable-dynamic-fps;
				qcom,mdss-dsi-pan-fps-update = "dfps_immediate_porch_mode";
			};
};
