/* Copyright (c) 2017, The Linux Foundation. All rights reserved.
 *
 * This program is free software; you can redistribute it and/or modify
 * it under the terms of the GNU General Public License version 2 and
 * only version 2 as published by the Free Software Foundation.
 *
 * This program is distributed in the hope that it will be useful,
 * but WITHOUT ANY WARRANTY; without even the implied warranty of
 * MERCHANTABILITY or FITNESS FOR A PARTICULAR PURPOSE.  See the
 * GNU General Public License for more details.
 */

&mdss_mdp {
	dsi_nt35596_1080p_skuk_pwm_video: qcom,mdss_dsi_nt35596_1080p_skuk_pwm_video {
				qcom,mdss-dsi-panel-name = "nt35596 1080p pwm video mode dsi panel skuk";
				qcom,mdss-dsi-panel-controller = <&mdss_dsi0>;
				qcom,mdss-dsi-panel-type = "dsi_video_mode";
				qcom,mdss-dsi-panel-destination = "display_1";
				qcom,mdss-dsi-panel-framerate = <60>;
				qcom,mdss-dsi-virtual-channel-id = <0>;
				qcom,mdss-dsi-stream = <0>;
				qcom,mdss-dsi-panel-width = <1080>;
				qcom,mdss-dsi-panel-height = <1920>;
				qcom,mdss-dsi-h-front-porch = <100>;
				qcom,mdss-dsi-h-back-porch = <82>;
				qcom,mdss-dsi-h-pulse-width = <8>;
				qcom,mdss-dsi-h-sync-skew = <0>;
				qcom,mdss-dsi-v-back-porch = <7>;
				qcom,mdss-dsi-v-front-porch = <3>;
				qcom,mdss-dsi-v-pulse-width = <2>;
				qcom,mdss-dsi-bpp = <24>;
				qcom,mdss-dsi-color-order = "rgb_swap_rgb";
				qcom,mdss-dsi-underflow-color = <0xff>;
				qcom,mdss-dsi-border-color = <0>;
				qcom,mdss-dsi-on-command = [29 01 00 00 00 00 02 ff 05
				29 01 00 00 00 00 02 fb 01
				29 01 00 00 05 00 02 c5 31
				29 01 00 00 01 00 02 ff 01
				29 01 00 00 00 00 02 fb 01
				29 01 00 00 00 00 02 00 01
				29 01 00 00 00 00 02 01 55
				29 01 00 00 00 00 02 02 45
				29 01 00 00 00 00 02 03 55
				29 01 00 00 00 00 02 05 50
				29 01 00 00 00 00 02 14 9e
				29 01 00 00 00 00 02 07 a8
				29 01 00 00 00 00 02 08 0c
				29 01 00 00 00 00 02 0b 96
				29 01 00 00 00 00 02 0c 96
				29 01 00 00 00 00 02 0e 00
				29 01 00 00 00 00 02 0f 00
				29 01 00 00 00 00 02 11 27
				29 01 00 00 00 00 02 12 27
				29 01 00 00 00 00 02 13 03
				29 01 00 00 00 00 02 06 0a
				29 01 00 00 00 00 02 15 99
				29 01 00 00 00 00 02 16 99
				29 01 00 00 00 00 02 1b 39
				29 01 00 00 00 00 02 1c 39
				29 01 00 00 00 00 02 1d 47
				29 01 00 00 00 00 02 44 c1
				29 01 00 00 00 00 02 45 86
				29 01 00 00 00 00 02 46 c4
				29 01 00 00 00 00 02 58 05
				29 01 00 00 00 00 02 59 05
				29 01 00 00 00 00 02 5a 05
				29 01 00 00 00 00 02 5b 05
				29 01 00 00 00 00 02 5c 00
				29 01 00 00 00 00 02 5d 00
				29 01 00 00 00 00 02 5e 00
				29 01 00 00 00 00 02 5f 00
				29 01 00 00 00 00 02 6d 44
				29 01 00 00 00 00 02 75 00
				29 01 00 00 00 00 02 76 6b
				29 01 00 00 00 00 02 77 00
				29 01 00 00 00 00 02 78 86
				29 01 00 00 00 00 02 79 00
				29 01 00 00 00 00 02 7a a3
				29 01 00 00 00 00 02 7b 00
				29 01 00 00 00 00 02 7c b5
				29 01 00 00 00 00 02 7d 00
				29 01 00 00 00 00 02 7e ca
				29 01 00 00 00 00 02 7f 00
				29 01 00 00 00 00 02 80 dd
				29 01 00 00 00 00 02 81 00
				29 01 00 00 00 00 02 82 f1
				29 01 00 00 00 00 02 83 01
				29 01 00 00 00 00 02 84 00
				29 01 00 00 00 00 02 85 01
				29 01 00 00 00 00 02 86 0d
				29 01 00 00 00 00 02 87 01
				29 01 00 00 00 00 02 88 34
				29 01 00 00 00 00 02 89 01
				29 01 00 00 00 00 02 8a 55
				29 01 00 00 00 00 02 8b 01
				29 01 00 00 00 00 02 8c 84
				29 01 00 00 00 00 02 8d 01
				29 01 00 00 00 00 02 8e ab
				29 01 00 00 00 00 02 8f 01
				29 01 00 00 00 00 02 90 ec
				29 01 00 00 00 00 02 91 02
				29 01 00 00 00 00 02 92 1f
				29 01 00 00 00 00 02 93 02
				29 01 00 00 00 00 02 94 21
				29 01 00 00 00 00 02 95 02
				29 01 00 00 00 00 02 96 5b
				29 01 00 00 00 00 02 97 02
				29 01 00 00 00 00 02 98 91
				29 01 00 00 00 00 02 99 02
				29 01 00 00 00 00 02 9a b7
				29 01 00 00 00 00 02 9b 02
				29 01 00 00 00 00 02 9c e5
				29 01 00 00 00 00 02 9d 03
				29 01 00 00 00 00 02 9e 08
				29 01 00 00 00 00 02 9f 03
				29 01 00 00 00 00 02 a0 3e
				29 01 00 00 00 00 02 a2 03
				29 01 00 00 00 00 02 a3 59
				29 01 00 00 00 00 02 a4 03
				29 01 00 00 00 00 02 a5 6f
				29 01 00 00 00 00 02 a6 03
				29 01 00 00 00 00 02 a7 8a
				29 01 00 00 01 00 02 a9 03
				29 01 00 00 00 00 02 aa a4
				29 01 00 00 00 00 02 ab 03
				29 01 00 00 00 00 02 ac c9
				29 01 00 00 00 00 02 ad 03
				29 01 00 00 00 00 02 ae dd
				29 01 00 00 00 00 02 af 03
				29 01 00 00 00 00 02 b0 f5
				29 01 00 00 00 00 02 b1 03
				29 01 00 00 00 00 02 b2 ff
				29 01 00 00 00 00 02 b3 00
				29 01 00 00 00 00 02 b4 6b
				29 01 00 00 00 00 02 b5 00
				29 01 00 00 00 00 02 b6 86
				29 01 00 00 00 00 02 b7 00
				29 01 00 00 00 00 02 b8 a3
				29 01 00 00 00 00 02 b9 00
				29 01 00 00 00 00 02 ba b5
				29 01 00 00 00 00 02 bb 00
				29 01 00 00 00 00 02 bc ca
				29 01 00 00 00 00 02 bd 00
				29 01 00 00 00 00 02 be dd
				29 01 00 00 00 00 02 bf 00
				29 01 00 00 00 00 02 c0 f1
				29 01 00 00 00 00 02 c1 01
				29 01 00 00 00 00 02 c2 00
				29 01 00 00 00 00 02 c3 01
				29 01 00 00 00 00 02 c4 0d
				29 01 00 00 00 00 02 c5 01
				29 01 00 00 00 00 02 c6 34
				29 01 00 00 00 00 02 c7 01
				29 01 00 00 00 00 02 c8 55
				29 01 00 00 00 00 02 c9 01
				29 01 00 00 00 00 02 ca 84
				29 01 00 00 00 00 02 cb 01
				29 01 00 00 00 00 02 cc ab
				29 01 00 00 00 00 02 cd 01
				29 01 00 00 00 00 02 ce ec
				29 01 00 00 00 00 02 cf 02
				29 01 00 00 00 00 02 d0 1f
				29 01 00 00 00 00 02 d1 02
				29 01 00 00 00 00 02 d2 21
				29 01 00 00 00 00 02 d3 02
				29 01 00 00 00 00 02 d4 5b
				29 01 00 00 00 00 02 d5 02
				29 01 00 00 00 00 02 d6 91
				29 01 00 00 00 00 02 d7 02
				29 01 00 00 00 00 02 d8 b7
				29 01 00 00 00 00 02 d9 02
				29 01 00 00 00 00 02 da e5
				29 01 00 00 00 00 02 db 03
				29 01 00 00 00 00 02 dc 08
				29 01 00 00 00 00 02 dd 03
				29 01 00 00 00 00 02 de 3e
				29 01 00 00 00 00 02 df 03
				29 01 00 00 00 00 02 e0 59
				29 01 00 00 00 00 02 e1 03
				29 01 00 00 00 00 02 e2 6f
				29 01 00 00 00 00 02 e3 03
				29 01 00 00 00 00 02 e4 8a
				29 01 00 00 00 00 02 e5 03
				29 01 00 00 00 00 02 e6 a4
				29 01 00 00 00 00 02 e7 03
				29 01 00 00 00 00 02 e8 c9
				29 01 00 00 00 00 02 e9 03
				29 01 00 00 00 00 02 ea dd
				29 01 00 00 00 00 02 eb 03
				29 01 00 00 00 00 02 ec f5
				29 01 00 00 00 00 02 ed 03
				29 01 00 00 00 00 02 ee ff
				29 01 00 00 00 00 02 ef 00
				29 01 00 00 00 00 02 f0 00
				29 01 00 00 00 00 02 f1 00
				29 01 00 00 00 00 02 f2 22
				29 01 00 00 00 00 02 f3 00
				29 01 00 00 00 00 02 f4 46
				29 01 00 00 00 00 02 f5 00
				29 01 00 00 00 00 02 f6 5c
				29 01 00 00 00 00 02 f7 00
				29 01 00 00 00 00 02 f8 76
				29 01 00 00 00 00 02 f9 00
				29 01 00 00 00 00 02 fa 8d
				29 01 00 00 01 00 02 ff 02
				29 01 00 00 00 00 02 fb 01
				29 01 00 00 00 00 02 00 00
				29 01 00 00 00 00 02 01 a6
				29 01 00 00 00 00 02 02 00
				29 01 00 00 00 00 02 03 b8
				29 01 00 00 00 00 02 04 00
				29 01 00 00 00 00 02 05 c7
				29 01 00 00 00 00 02 06 00
				29 01 00 00 00 00 02 07 f6
				29 01 00 00 00 00 02 08 01
				29 01 00 00 00 00 02 09 1d
				29 01 00 00 00 00 02 0a 01
				29 01 00 00 00 00 02 0b 54
				29 01 00 00 00 00 02 0c 01
				29 01 00 00 00 00 02 0d 81
				29 01 00 00 00 00 02 0e 01
				29 01 00 00 00 00 02 0f cb
				29 01 00 00 00 00 02 10 02
				29 01 00 00 00 00 02 11 05
				29 01 00 00 00 00 02 12 02
				29 01 00 00 00 00 02 13 07
				29 01 00 00 00 00 02 14 02
				29 01 00 00 00 00 02 15 47
				29 01 00 00 00 00 02 16 02
				29 01 00 00 00 00 02 17 82
				29 01 00 00 00 00 02 18 02
				29 01 00 00 00 00 02 19 ab
				29 01 00 00 00 00 02 1a 02
				29 01 00 00 00 00 02 1b dc
				29 01 00 00 00 00 02 1c 03
				29 01 00 00 00 00 02 1d 01
				29 01 00 00 00 00 02 1e 03
				29 01 00 00 00 00 02 1f 3a
				29 01 00 00 00 00 02 20 03
				29 01 00 00 00 00 02 21 56
				29 01 00 00 00 00 02 22 03
				29 01 00 00 00 00 02 23 6d
				29 01 00 00 00 00 02 24 03
				29 01 00 00 00 00 02 25 89
				29 01 00 00 00 00 02 26 03
				29 01 00 00 00 00 02 27 a3
				29 01 00 00 00 00 02 28 03
				29 01 00 00 00 00 02 29 c9
				29 01 00 00 00 00 02 2a 03
				29 01 00 00 00 00 02 2b dd
				29 01 00 00 00 00 02 2d 03
				29 01 00 00 00 00 02 2f f5
				29 01 00 00 00 00 02 30 03
				29 01 00 00 00 00 02 31 ff
				29 01 00 00 00 00 02 32 00
				29 01 00 00 00 00 02 33 00
				29 01 00 00 00 00 02 34 00
				29 01 00 00 00 00 02 35 22
				29 01 00 00 00 00 02 36 00
				29 01 00 00 00 00 02 37 46
				29 01 00 00 00 00 02 38 00
				29 01 00 00 00 00 02 39 5c
				29 01 00 00 00 00 02 3a 00
				29 01 00 00 00 00 02 3b 76
				29 01 00 00 00 00 02 3d 00
				29 01 00 00 00 00 02 3f 8d
				29 01 00 00 00 00 02 40 00
				29 01 00 00 00 00 02 41 a6
				29 01 00 00 00 00 02 42 00
				29 01 00 00 00 00 02 43 b8
				29 01 00 00 00 00 02 44 00
				29 01 00 00 00 00 02 45 c7
				29 01 00 00 00 00 02 46 00
				29 01 00 00 00 00 02 47 f6
				29 01 00 00 00 00 02 48 01
				29 01 00 00 00 00 02 49 1d
				29 01 00 00 00 00 02 4a 01
				29 01 00 00 00 00 02 4b 54
				29 01 00 00 00 00 02 4c 01
				29 01 00 00 00 00 02 4d 81
				29 01 00 00 00 00 02 4e 01
				29 01 00 00 00 00 02 4f cb
				29 01 00 00 00 00 02 50 02
				29 01 00 00 00 00 02 51 05
				29 01 00 00 00 00 02 52 02
				29 01 00 00 00 00 02 53 07
				29 01 00 00 00 00 02 54 02
				29 01 00 00 00 00 02 55 47
				29 01 00 00 00 00 02 56 02
				29 01 00 00 00 00 02 58 82
				29 01 00 00 00 00 02 59 02
				29 01 00 00 00 00 02 5a ab
				29 01 00 00 00 00 02 5b 02
				29 01 00 00 00 00 02 5c dc
				29 01 00 00 00 00 02 5d 03
				29 01 00 00 00 00 02 5e 01
				29 01 00 00 00 00 02 5f 03
				29 01 00 00 00 00 02 60 3a
				29 01 00 00 00 00 02 61 03
				29 01 00 00 00 00 02 62 56
				29 01 00 00 00 00 02 63 03
				29 01 00 00 00 00 02 64 6d
				29 01 00 00 00 00 02 65 03
				29 01 00 00 00 00 02 66 89
				29 01 00 00 00 00 02 67 03
				29 01 00 00 00 00 02 68 a3
				29 01 00 00 00 00 02 69 03
				29 01 00 00 00 00 02 6a c9
				29 01 00 00 00 00 02 6b 03
				29 01 00 00 00 00 02 6c dd
				29 01 00 00 00 00 02 6d 03
				29 01 00 00 00 00 02 6e f5
				29 01 00 00 00 00 02 6f 03
				29 01 00 00 00 00 02 70 ff
				29 01 00 00 00 00 02 71 00
				29 01 00 00 00 00 02 72 00
				29 01 00 00 00 00 02 73 00
				29 01 00 00 00 00 02 74 22
				29 01 00 00 00 00 02 75 00
				29 01 00 00 00 00 02 76 46
				29 01 00 00 00 00 02 77 00
				29 01 00 00 00 00 02 78 5c
				29 01 00 00 00 00 02 79 00
				29 01 00 00 00 00 02 7a 76
				29 01 00 00 00 00 02 7b 00
				29 01 00 00 00 00 02 7c 8d
				29 01 00 00 00 00 02 7d 00
				29 01 00 00 00 00 02 7e a6
				29 01 00 00 00 00 02 7f 00
				29 01 00 00 00 00 02 80 b8
				29 01 00 00 00 00 02 81 00
				29 01 00 00 00 00 02 82 c7
				29 01 00 00 00 00 02 83 00
				29 01 00 00 00 00 02 84 f6
				29 01 00 00 00 00 02 85 01
				29 01 00 00 00 00 02 86 1d
				29 01 00 00 00 00 02 87 01
				29 01 00 00 00 00 02 88 54
				29 01 00 00 00 00 02 89 01
				29 01 00 00 00 00 02 8a 81
				29 01 00 00 00 00 02 8b 01
				29 01 00 00 00 00 02 8c cb
				29 01 00 00 00 00 02 8d 02
				29 01 00 00 00 00 02 8e 05
				29 01 00 00 00 00 02 8f 02
				29 01 00 00 00 00 02 90 07
				29 01 00 00 00 00 02 91 02
				29 01 00 00 00 00 02 92 47
				29 01 00 00 00 00 02 93 02
				29 01 00 00 00 00 02 94 82
				29 01 00 00 00 00 02 95 02
				29 01 00 00 00 00 02 96 ab
				29 01 00 00 00 00 02 97 02
				29 01 00 00 00 00 02 98 dc
				29 01 00 00 00 00 02 99 03
				29 01 00 00 00 00 02 9a 01
				29 01 00 00 00 00 02 9b 03
				29 01 00 00 00 00 02 9c 3a
				29 01 00 00 00 00 02 9d 03
				29 01 00 00 00 00 02 9e 56
				29 01 00 00 00 00 02 9f 03
				29 01 00 00 00 00 02 a0 6d
				29 01 00 00 00 00 02 a2 03
				29 01 00 00 00 00 02 a3 89
				29 01 00 00 00 00 02 a4 03
				29 01 00 00 00 00 02 a5 a3
				29 01 00 00 00 00 02 a6 03
				29 01 00 00 00 00 02 a7 c9
				29 01 00 00 00 00 02 a9 03
				29 01 00 00 00 00 02 aa dd
				29 01 00 00 00 00 02 ab 03
				29 01 00 00 00 00 02 ac f5
				29 01 00 00 00 00 02 ad 03
				29 01 00 00 00 00 02 ae ff
				29 01 00 00 00 00 02 af 00
				29 01 00 00 00 00 02 b0 00
				29 01 00 00 00 00 02 b1 00
				29 01 00 00 00 00 02 b2 22
				29 01 00 00 00 00 02 b3 00
				29 01 00 00 00 00 02 b4 46
				29 01 00 00 00 00 02 b5 00
				29 01 00 00 00 00 02 b6 5c
				29 01 00 00 00 00 02 b7 00
				29 01 00 00 00 00 02 b8 76
				29 01 00 00 00 00 02 b9 00
				29 01 00 00 00 00 02 ba 8d
				29 01 00 00 00 00 02 bb 00
				29 01 00 00 00 00 02 bc a6
				29 01 00 00 00 00 02 bd 00
				29 01 00 00 00 00 02 be b8
				29 01 00 00 00 00 02 bf 00
				29 01 00 00 00 00 02 c0 c7
				29 01 00 00 00 00 02 c1 00
				29 01 00 00 00 00 02 c2 f6
				29 01 00 00 00 00 02 c3 01
				29 01 00 00 00 00 02 c4 1d
				29 01 00 00 00 00 02 c5 01
				29 01 00 00 00 00 02 c6 54
				29 01 00 00 00 00 02 c7 01
				29 01 00 00 00 00 02 c8 81
				29 01 00 00 00 00 02 c9 01
				29 01 00 00 00 00 02 ca cb
				29 01 00 00 00 00 02 cb 02
				29 01 00 00 00 00 02 cc 05
				29 01 00 00 00 00 02 cd 02
				29 01 00 00 00 00 02 ce 07
				29 01 00 00 00 00 02 cf 02
				29 01 00 00 00 00 02 d0 47
				29 01 00 00 00 00 02 d1 02
				29 01 00 00 00 00 02 d2 82
				29 01 00 00 00 00 02 d3 02
				29 01 00 00 00 00 02 d4 ab
				29 01 00 00 00 00 02 d5 02
				29 01 00 00 00 00 02 d6 dc
				29 01 00 00 00 00 02 d7 03
				29 01 00 00 00 00 02 d8 01
				29 01 00 00 00 00 02 d9 03
				29 01 00 00 00 00 02 da 3a
				29 01 00 00 00 00 02 db 03
				29 01 00 00 00 00 02 dc 56
				29 01 00 00 00 00 02 dd 03
				29 01 00 00 00 00 02 de 6d
				29 01 00 00 00 00 02 df 03
				29 01 00 00 00 00 02 e0 89
				29 01 00 00 00 00 02 e1 03
				29 01 00 00 00 00 02 e2 a3
				29 01 00 00 00 00 02 e3 03
				29 01 00 00 00 00 02 e4 c9
				29 01 00 00 00 00 02 e5 03
				29 01 00 00 00 00 02 e6 dd
				29 01 00 00 00 00 02 e7 03
				29 01 00 00 00 00 02 e8 f5
				29 01 00 00 00 00 02 e9 03
				29 01 00 00 00 00 02 ea ff
				29 01 00 00 00 00 02 eb 30
				29 01 00 00 00 00 02 ec 17
				29 01 00 00 00 00 02 ed 20
				29 01 00 00 00 00 02 ee 0f
				29 01 00 00 00 00 02 ef 1f
				29 01 00 00 00 00 02 f0 0f
				29 01 00 00 00 00 02 f1 0f
				29 01 00 00 00 00 02 f2 07
				29 01 00 00 01 00 02 ff 05
				29 01 00 00 00 00 02 fb 01
				29 01 00 00 00 00 02 00 0f
				29 01 00 00 00 00 02 01 00
				29 01 00 00 00 00 02 02 00
				29 01 00 00 00 00 02 03 00
				29 01 00 00 00 00 02 04 0b
				29 01 00 00 00 00 02 05 0c
				29 01 00 00 00 00 02 06 00
				29 01 00 00 00 00 02 07 00
				29 01 00 00 00 00 02 08 00
				29 01 00 00 00 00 02 09 00
				29 01 00 00 00 00 02 0a 03
				29 01 00 00 00 00 02 0b 04
				29 01 00 00 00 00 02 0c 01
				29 01 00 00 00 00 02 0d 13
				29 01 00 00 00 00 02 0e 15
				29 01 00 00 00 00 02 0f 17
				29 01 00 00 00 00 02 10 0f
				29 01 00 00 00 00 02 11 00
				29 01 00 00 00 00 02 12 00
				29 01 00 00 00 00 02 13 00
				29 01 00 00 00 00 02 14 0b
				29 01 00 00 00 00 02 15 0c
				29 01 00 00 00 00 02 16 00
				29 01 00 00 00 00 02 17 00
				29 01 00 00 00 00 02 18 00
				29 01 00 00 00 00 02 19 00
				29 01 00 00 00 00 02 1a 03
				29 01 00 00 00 00 02 1b 04
				29 01 00 00 00 00 02 1c 01
				29 01 00 00 00 00 02 1d 13
				29 01 00 00 00 00 02 1e 15
				29 01 00 00 00 00 02 1f 17
				29 01 00 00 00 00 02 20 09
				29 01 00 00 00 00 02 21 01
				29 01 00 00 00 00 02 22 00
				29 01 00 00 00 00 02 23 00
				29 01 00 00 00 00 02 24 00
				29 01 00 00 00 00 02 25 ed
				29 01 00 00 00 00 02 29 58
				29 01 00 00 00 00 02 2a 16
				29 01 00 00 00 00 02 2b 05
				29 01 00 00 00 00 02 2f 02
				29 01 00 00 00 00 02 30 04
				29 01 00 00 00 00 02 31 49
				29 01 00 00 00 00 02 32 23
				29 01 00 00 00 00 02 33 01
				29 01 00 00 00 00 02 34 00
				29 01 00 00 00 00 02 35 69
				29 01 00 00 00 00 02 36 00
				29 01 00 00 00 00 02 37 2d
				29 01 00 00 00 00 02 38 18
				29 01 00 00 00 00 02 5b 00
				29 01 00 00 00 00 02 5f 75
				29 01 00 00 00 00 02 63 00
				29 01 00 00 00 00 02 67 04
				29 01 00 00 00 00 02 6c 04
				29 01 00 00 00 00 02 90 00
				29 01 00 00 00 00 02 74 10
				29 01 00 00 00 00 02 75 19
				29 01 00 00 00 00 02 76 06
				29 01 00 00 00 00 02 77 03
				29 01 00 00 00 00 02 78 02
				29 01 00 00 00 00 02 79 00
				29 01 00 00 00 00 02 7b 80
				29 01 00 00 00 00 02 7c d8
				29 01 00 00 00 00 02 7d 60
				29 01 00 00 00 00 02 7e 10
				29 01 00 00 00 00 02 7f 19
				29 01 00 00 00 00 02 80 00
				29 01 00 00 00 00 02 81 06
				29 01 00 00 00 00 02 82 03
				29 01 00 00 00 00 02 83 00
				29 01 00 00 00 00 02 84 03
				29 01 00 00 00 00 02 85 07
				29 01 00 00 00 00 02 86 1b
				29 01 00 00 00 00 02 87 39
				29 01 00 00 00 00 02 88 1b
				29 01 00 00 00 00 02 89 39
				29 01 00 00 00 00 02 8a 33
				29 01 00 00 00 00 02 b5 20
				29 01 00 00 00 00 02 8c 01
				29 01 00 00 00 00 02 91 4c
				29 01 00 00 00 00 02 92 79
				29 01 00 00 00 00 02 93 04
				29 01 00 00 00 00 02 94 04
				29 01 00 00 00 00 02 98 00
				29 01 00 00 00 00 02 99 33
				29 01 00 00 00 00 02 9b 0f
				29 01 00 00 00 00 02 a4 0f
				29 01 00 00 00 00 02 9d b0
				29 01 00 00 00 00 02 c4 24
				29 01 00 00 00 00 02 c6 00
				29 01 00 00 01 00 02 ff 23
				29 01 00 00 00 00 02 08 04
				29 01 00 00 00 00 02 fb 01
				29 01 00 00 00 00 02 ec 01
				29 01 00 00 01 00 02 ff 00
				29 01 00 00 00 00 02 d3 09
				29 01 00 00 00 00 02 d4 0a
				29 01 00 00 00 00 02 51 00
				29 01 00 00 00 00 02 53 00
				29 01 00 00 00 00 02 54 00
				29 01 00 00 00 00 02 55 00
				29 01 00 00 78 00 02 11 00
				29 01 00 00 00 00 02 29 00];
				qcom,mdss-dsi-off-command = [05 01 00 00 32 00 02 28 00
							05 01 00 00 78 00 02 10 00];
				qcom,mdss-dsi-on-command-state = "dsi_lp_mode";
				qcom,mdss-dsi-off-command-state = "dsi_hs_mode";
				qcom,mdss-dsi-panel-status-command = [06 01 00 01 05 00 02 0A 08];
				qcom,mdss-dsi-panel-status-command-state = "dsi_lp_mode";
				qcom,mdss-dsi-panel-status-check-mode = "reg_read_nt35596";
				qcom,mdss-dsi-panel-status-value = <0x9c>;
				qcom,mdss-dsi-h-sync-pulse = <1>;
				qcom,mdss-dsi-traffic-mode = "burst_mode";
				qcom,mdss-dsi-lane-map = "lane_map_0123";
				qcom,mdss-dsi-bllp-eof-power-mode;
				qcom,mdss-dsi-bllp-power-mode;
				qcom,mdss-dsi-lane-0-state;
				qcom,mdss-dsi-lane-1-state;
				qcom,mdss-dsi-lane-2-state;
				qcom,mdss-dsi-lane-3-state;
				qcom,mdss-dsi-panel-timings = [9e 43 37 00 60 58 39 45 5b 03 04 00];
				qcom,mdss-dsi-t-clk-post = <0x1e>;
				qcom,mdss-dsi-t-clk-pre = <0x38>;
				qcom,mdss-dsi-bl-min-level = <1>;
				qcom,mdss-dsi-bl-max-level = <255>;
				qcom,mdss-dsi-dma-trigger = "trigger_sw";
				qcom,mdss-dsi-mdp-trigger = "none";
				qcom,mdss-dsi-bl-pmic-control-type = "bl_ctrl_pwm";
				qcom,mdss-dsi-bl-pmic-pwm-frequency = <50>;
				qcom,mdss-dsi-bl-pmic-bank-select = <0>;
				qcom,mdss-dsi-pwm-gpio = <108 4 0>;
				qcom,mdss-dsi-reset-sequence = <0 20>,<0 40>,<1 20>;
				qcom,mdss-pan-physical-width-dimension = <62>;
				qcom,mdss-pan-physical-height-dimension = <110>;
				qcom,cont-splash-enabled;
				qcom,esd-check-enabled;
				qcom,mdss-dsi-pan-enable-dynamic-fps;
				qcom,mdss-dsi-pan-fps-update = "dfps_immediate_porch_mode";
			};
		};
