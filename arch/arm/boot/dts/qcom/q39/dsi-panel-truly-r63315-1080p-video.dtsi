/* Copyright (c) 2017, The Linux Foundation. All rights reserved.
 *
 * This program is free software; you can redistribute it and/or modify
 * it under the terms of the GNU General Public License version 2 and
 * only version 2 as published by the Free Software Foundation.
 *
 * This program is distributed in the hope that it will be useful,
 * but WITHOUT ANY WARRANTY; without even the implied warranty of
 * MERCHANTABILITY or FITNESS FOR A PARTICULAR PURPOSE.  See the
 * GNU General Public License for more details.
 */
&mdss_mdp {
	dsi_r63315_video: qcom,mdss_dsi_r63315_video {
			qcom,mdss-dsi-panel-name = "truly 1080p video mode dsi panel";
			qcom,mdss-dsi-panel-controller = <&mdss_dsi0>;
			qcom,mdss-dsi-panel-type = "dsi_video_mode";
			qcom,mdss-dsi-panel-destination = "display_1";
			qcom,mdss-dsi-panel-framerate = <60>;
			qcom,mdss-dsi-virtual-channel-id = <0>;
			qcom,mdss-dsi-stream = <0>;
			qcom,mdss-dsi-panel-width = <1080>;
			qcom,mdss-dsi-panel-height = <1920>;
			qcom,mdss-dsi-h-front-porch = <90>;
			qcom,mdss-dsi-h-back-porch = <60>;
			qcom,mdss-dsi-h-pulse-width = <20>;
			qcom,mdss-dsi-h-sync-skew = <0>;
			qcom,mdss-dsi-v-back-porch = <4>;
			qcom,mdss-dsi-v-front-porch = <10>;
			qcom,mdss-dsi-v-pulse-width = <3>;
			qcom,mdss-dsi-h-left-border = <0>;
			qcom,mdss-dsi-h-right-border = <0>;
			qcom,mdss-dsi-v-top-border = <0>;
			qcom,mdss-dsi-v-bottom-border = <0>;
			qcom,mdss-dsi-bpp = <24>;
			qcom,mdss-dsi-color-order = "rgb_swap_rgb";
			qcom,mdss-dsi-underflow-color = <0xff>;
			qcom,mdss-dsi-border-color = <0>;
			qcom,mdss-dsi-on-command = [23 01 00 00 00 00 02 b0 04 23 01 00 00 00 00 02 00 00 23 01 00 00 00 00 02 00 00 29 01 00 00 00 00 07 b3 14 00 00 00 00 00 29 01 00 00 00 00 03 b6 3a b3 29 01 00 00 00 00 02 c0 00 29 01 00 00 00 00 30 23 c1 84 60 10 eb ff 6f ce ff ff 17 12 58 73 ae 31 20 c6 ff ff 1f f3 ff 5f 10 10 10 10 00 62 01 22 22 00 01 29 01 00 00 00 00 08 c2 31 f7 80 06 08 80 00 29 01 00 00 00 00 17 c4 70 00 00 00 00 00 00 00 00 0c 06 00 00 00 00 00 00 00 00 00 0c 06 29 01 00 00 00 00 29 c6 00 08 67 08 67 00 00 00 00 00 00 00 00 00 00 00 00 16 18 08 00 08 67 08 67 00 00 00 00 00 00 00 00 00 00 00 00 16 18 08 29 01 00 00 00 00 1f c7 00 0d 19 20 2c 38 42 50 34 3c 4a 5d 68 6d 71 00 0d 19 20 2c 38 42 50 34 3c 4a 5d 68 6d 71 29 01 00 00 00 00 14 c8 00 00 00 00 00 fc 00 00 00 00 00 fc 00 00 00 00 00 fc 00 29 01 00 00 00 00 0a cb 31 fc 3f 8c 00 00 00 00 c0 29 01 00 00 00 00 02 cc 0b 29 01 00 00 00 00 0b d0 11 81 bb 19 99 4c 19 19 0c 00 29 01 00 00 00 00 1a d3 1b 33 bb bb b3 33 33 33 01 01 00 a0 d8 a0 0d 48 48 44 3b 37 72 07 3d bf 33 29 01 00 00 00 00 08 d5 06 00 00 01 42 01 42 29 01 00 00 00 00 08 d5 06 00 00 01 42 01 42 29 01 00 00 00 00 02 d6 01 15 01 00 00 00 00 02 51 00 15 01 00 00 00 00 02 53 2f 15 01 00 00 00 00 02 55 00 05 01 00 00 32 00 02 29 00 05 01 00 00 c8 00 02 11 00];
			qcom,mdss-dsi-off-command = [05 01 00 00 32 00 02 28 00 
						05 01 00 00 78 00 02 10 00];
			qcom,mdss-dsi-on-command-state = "dsi_lp_mode";
			qcom,mdss-dsi-off-command-state = "dsi_hs_mode";
			qcom,mdss-dsi-h-sync-pulse = <1>;
			qcom,mdss-dsi-traffic-mode = "burst_mode";
			qcom,mdss-dsi-lane-map = "lane_map_0123";
			qcom,mdss-dsi-bllp-eof-power-mode;
			qcom,mdss-dsi-bllp-power-mode;
			qcom,mdss-dsi-lane-0-state;
			qcom,mdss-dsi-lane-1-state;
			qcom,mdss-dsi-lane-2-state;
			qcom,mdss-dsi-lane-3-state;
			qcom,mdss-dsi-panel-timings = [f9 3a 28 00 6e 70 2c 3e 31 03 04 00];
			qcom,mdss-dsi-t-clk-post = <0x1e>;
			qcom,mdss-dsi-t-clk-pre = <0x38>;
			qcom,mdss-dsi-bl-min-level = <1>;
			qcom,mdss-dsi-bl-max-level = <255>;
			qcom,mdss-dsi-dma-trigger = "trigger_sw";
			qcom,mdss-dsi-mdp-trigger = "none";
			qcom,mdss-dsi-bl-pmic-control-type = "bl_ctrl_dcs";
			qcom,mdss-dsi-reset-sequence = <0 20>,<0 20>,<1 20>;
			qcom,cont-splash-enabled;
			qcom,esd-check-enabled;
			qcom,mdss-dsi-pan-enable-dynamic-fps;
			qcom,mdss-dsi-pan-fps-update = "dfps_immediate_porch_mode";
		};
	};
